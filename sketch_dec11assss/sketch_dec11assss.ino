bool led_1 = false;
unsigned long timing;                                    // Переменная для хранения точки отсчета

int milliseconds        = 20;                            // через сколько миллисекунд после включения светодиода будем его выключать
int countLeds           = 4;                             // Сколько всего светодиодов у нас подключено
bool arrLeds[4]         = {false, false, false, false};  // В этом массиве храним обозначения включен ли светодиод или нет
int arrAnalogs[4]       = {A0, A1, A2, A3};              // Массив аналоговых портов, читающихданные с микрофона
int arrDigitals[4]      = {8, 9, 10, 11};                // Масив диджитал портов, которые будут включать светодиоды
int Levels[]            = {300,150,150,150};             // Уровни сигналов, при которых будут включаться светодиоды
int Timings[]           = {0,0,0,0};                     // В этом массиве будем хранить значения таймингов для проверок

void setup() {                                           // в начале работы обозначаем порты, с которыми будем работать
  for (int i = 0; i < countLeds; i++) {                  // переберем диджитал порты
    pinMode(arrDigitals[i],OUTPUT); 
  }
  for (int i = 0; i < countLeds; i++) {                  // переберем аналоговые порты
    pinMode(arrAnalogs[i],INPUT); 
  }
  Serial.begin(9600);                                    // Задаем скорость работы монитора порта 
}

void loop() {
    LedOnOff();                                          // вызываем функцию включения/выключения светодиода
}






void LedOnOff() {                                        // функция включения/выключения светодиода
    for (int i = 0; i < countLeds; i++) {                // переберем аналоговые порты
        if(arrLeds[i] == false){                         // Если светодиод не включен, то проверяем уровень сигнала, иначепроверяем сколько времени прошло с момента включения и если больше milliseconds то выключаем
            if(analogRead(arrAnalogs[i]) > Levels[i]) {  // Проверяем уровень сигнала, полученный с микрофона на порт A0. Если значение больше 300 то:
                digitalWrite(arrDigitals[i],true);       // подаем сигнал на порт D8, чтобы включить светодиод  
                Timings[i] = millis(); 
                arrLeds[i] = true;
            }
        }else{
          if (millis() - Timings[i] > milliseconds){      // проверяем сколько времени прошло с момента включения и, если больше milliseconds, то выключаем
              digitalWrite(arrDigitals[i],false);
              arrLeds[i] = false;
          }    
        }
    }  
}
